## CMakeLists.txt
```
cmake_minimum_required(VERSION 3.20.0)
find_package(Zephyr REQUIRED HINTS $ENV{ZEPHYR_BASE})
project(COMP8800_Proxy)
target_sources(app PRIVATE 
    src/main.c
    src/proxy_gatt.c
    src/provisioner.c
    ../general/mesh.c
)

include_directories(
    ../general
    ${ZEPHYR_BASE}/../modules/crypto/mbedtls/include
    ${ZEPHYR_BASE}/../modules/crypto/mbedtls/include/psa
)

zephyr_library_include_directories(.)
include_directories(${CMAKE_CURRENT_BINARY_DIR})
zephyr_library_include_directories(${CMAKE_CURRENT_BINARY_DIR}/prxy/zephyr/include/generated)
```

## prj.conf
```kconfig
# logging
CONFIG_LOG=y
CONFIG_USE_SEGGER_RTT=y
CONFIG_RTT_CONSOLE=y
CONFIG_CONSOLE=y
CONFIG_FPU=y
CONFIG_LOG_DEFAULT_LEVEL=3
CONFIG_LOG_BACKEND_UART=y
CONFIG_LOG_BACKEND_RTT=y

CONFIG_DK_LIBRARY=y
CONFIG_BT_DEVICE_NAME="nRF_proxy"
CONFIG_BT_DEVICE_NAME_DYNAMIC=y
CONFIG_MINIMAL_LIBC=y
CONFIG_NEWLIB_LIBC=n
CONFIG_EVENTS=y

# smp
CONFIG_BT_SMP=y

# flash
CONFIG_FLASH=y
CONFIG_FLASH_MAP=y
CONFIG_STREAM_FLASH=y

# security
CONFIG_HW_STACK_PROTECTION=n
CONFIG_MPU_STACK_GUARD=n
CONFIG_ARM_MPU=n
CONFIG_MPU=n

# bluetooth
CONFIG_BT=y
CONFIG_BT_PERIPHERAL=y
CONFIG_BT_OBSERVER=y
CONFIG_BT_CENTRAL=n
CONFIG_BT_MESH_PROVISIONER=y
CONFIG_BT_MESH_PROVISIONEE=n
CONFIG_BT_BROADCASTER=y
CONFIG_BT_GATT_CLIENT=y

# mesh
CONFIG_BT_MESH=y
CONFIG_BT_MESH_CDB=y
CONFIG_BT_MESH_PB_ADV=y
CONFIG_BT_MESH_MODEL_EXTENSIONS=n
CONFIG_BT_MESH_CDB=y
CONFIG_BT_MESH_CFG_CLI=y
CONFIG_BT_MESH_HEALTH_CLI=y
CONFIG_BT_MESH_RELAY=n
CONFIG_BT_MESH_FRIEND=n
CONFIG_BT_MESH_GATT_PROXY=y

# advertising
CONFIG_BT_ADV_PROV=y
CONFIG_BT_EXT_ADV=y
CONFIG_BT_MESH_ADV_LEGACY=n
CONFIG_BT_EXT_ADV_LEGACY_SUPPORT=y

# mbedtls
CONFIG_MBEDTLS_USE_PSA_CRYPTO=y
CONFIG_MBEDTLS_PSA_CRYPTO_C=y
CONFIG_BT_MESH_USES_MBEDTLS_PSA=y
CONFIG_BT_MESH_USES_TFM_PSA=n
CONFIG_PSA_WANT_KEY_TYPE_AES=y
CONFIG_MBEDTLS_LEGACY_CRYPTO_C=y
CONFIG_MBEDTLS_SHA256_C=y
CONFIG_TRUSTED_STORAGE=n
CONFIG_MBEDTLS_PSA_CRYPTO_STORAGE_C=n
CONFIG_BUILD_WITH_TFM=n

# random number generation
CONFIG_ENTROPY_BT_HCI=y
CONFIG_ENTROPY_GENERATOR=y

# settings
CONFIG_SETTINGS=y
CONFIG_BT_SETTINGS=y
CONFIG_NVS=y
CONFIG_SETTINGS_NVS=y
CONFIG_SECURE_STORAGE=y

# buffer, memory & connection config
CONFIG_BT_MAX_CONN=12
CONFIG_BT_MAX_PAIRED=3
CONFIG_BT_CTLR_ADV_SET=8
CONFIG_BT_CTLR_DATA_LENGTH_MAX=251
CONFIG_BT_BUF_ACL_RX_SIZE=251
CONFIG_BT_BUF_ACL_TX_SIZE=251
CONFIG_BT_L2CAP_TX_MTU=251
CONFIG_BT_MESH_ADV_BUF_COUNT=64
CONFIG_BT_MESH_TX_SEG_MAX=8
CONFIG_BT_MESH_RX_SEG_MAX=8
CONFIG_BT_L2CAP_TX_BUF_COUNT=8
CONFIG_BT_BUF_ACL_RX_COUNT_EXTRA=9 
CONFIG_BT_BUF_ACL_TX_COUNT=9
CONFIG_BT_CTLR_ADV_EXT=y
CONFIG_BT_CTLR_SDC_PERIPHERAL_COUNT=3
CONFIG_MAIN_STACK_SIZE=4096
CONFIG_SYSTEM_WORKQUEUE_STACK_SIZE=4096

# external storage
CONFIG_NORDIC_QSPI_NOR=y
CONFIG_PM_EXTERNAL_FLASH_MCUBOOT_SECONDARY=y
CONFIG_PARTITION_MANAGER_ENABLED=y

# mcuboot
CONFIG_BOOTLOADER_MCUBOOT=y
CONFIG_DFU_TARGET=y
CONFIG_DFU_TARGET_MCUBOOT=y
CONFIG_MCUBOOT_BOOTUTIL_LIB=y
CONFIG_NCS_SAMPLE_MCUMGR_BT_OTA_DFU=y
CONFIG_IMG_MANAGER=y
CONFIG_MCUBOOT_IMG_MANAGER=y
CONFIG_MCUMGR_GRP_IMG=y
CONFIG_MCUMGR_GRP_OS=y
```

## src/main.c
```c
#include <zephyr/logging/log.h>
#include <zephyr/bluetooth/bluetooth.h>
#include <dk_buttons_and_leds.h>
#include <zephyr/bluetooth/conn.h>
#include <zephyr/bluetooth/addr.h> 
#include <zephyr/bluetooth/mesh.h>

#include <zephyr/settings/settings.h>
#include <zephyr/random/random.h>
#include <zephyr/bluetooth/uuid.h>
#include <zephyr/bluetooth/gatt.h>

LOG_MODULE_REGISTER(main_log);

#include "proxy_gatt.h"
#include "provisioner.h"
#include "mesh.h"
#include "common.h"

#define DEV_UUID_LEN            16

K_SEM_DEFINE(sem_bt_init, 0, 1);

K_EVENT_DEFINE(evnt_bt_init);
#define  BT_INIT_BIT    BIT(0)

static uint8_t dev_uuid[DEV_UUID_LEN];
static struct k_work gatt_ad_work;


// --------------------------------
// GATT setup

// catch failed connections & turn connection LED on
static void on_connected(struct bt_conn *conn, uint8_t err)
{
    if(err) {
        LOG_INF("BT connection failed with %d\n", err);
        return;
    }
    LOG_INF("BT connection established.\n");
    dk_set_led_on(CONNECTION_LED);
    
    k_sleep(K_MSEC(TINY_INTERVAL));

    // enable gatt
    k_work_submit(&gatt_ad_work);
    conn_curr = conn;

    // capture basic information about the current connection
    struct bt_conn_info info;
    err  = bt_conn_get_info(conn, &info);
    if(err<0) {
        LOG_ERR("Connection information retrieval failed with %d",err);
        return;
    }
    
    LOG_INF("Connection parameters: Interval %.2f ms, timeout %.2d ms, latency %d intervals",
    info.le.interval*1.25, info.le.timeout*10, info.le.latency);
}

// catch disconnection & turn connection LED off
static void on_disconnected(struct bt_conn *conn, uint8_t err)
{
    LOG_INF("GATT disconnected.");
    dk_set_led_off(CONNECTION_LED);

    err = bt_conn_disconnect(conn_curr, BT_HCI_ERR_REMOTE_USER_TERM_CONN);
    if(err) {
        LOG_INF("Failed to disconnect from Bluetooth client with %d", err);
    }
    else  {
        LOG_INF("Disconnected from Bluetooth client");
    }

    conn_curr = NULL;    
    bt_mesh_proxy_identity_enable();
}

// connection object has been returned to the pool
static void on_recycled(void)
{
    LOG_INF("Connection object returned to pool - disconnection complete.");
}

// connected device has updated the connection parameters
static void on_le_param_updated(struct bt_conn *conn, uint16_t interval, uint16_t latency, uint16_t timeout)
{
    LOG_INF("Connection parameters updated: Interval %.2f ms, timeout %.2d ms, latency %d intervals",
    interval*1.25, timeout*10, latency);
}

// handle callbacks for different connection states
static struct bt_conn_cb conn_callbacks = {
    .connected = on_connected,
    .disconnected = on_disconnected,
    .recycled = on_recycled,
    .le_param_updated = on_le_param_updated,
    // .le_data_len_updated = on_le_data_len_updated,
};

// data won't send if GATT isn't advertising, so there's no point wasting the resources
void send_sensor_data(void)
{
    int err;
    k_event_wait(&evnt_bt_init, BT_INIT_BIT, false, K_FOREVER);
    for(;;) {
        if(conn_curr != NULL) {
            err = send_sensor_notification();
            if(err) {
                LOG_WRN("Characteristic transmission failed with %d (are your attribute indexes correct?)", err);
            }
            
        }
       
        k_sleep(K_MSEC(LONG_INTERVAL));
    }
}

// -------------------------------------
// health client stuff

static struct bt_mesh_cfg_cli cfg_cli = {};

static void disp_health_current_status(struct bt_mesh_health_cli *cli, uint16_t addr, uint8_t test_id, uint16_t cid, uint8_t *faults, size_t fault_count)
{
    LOG_INF("Getting health status of device @ 0x%04x: test_id %u, cid 0x%04x, fault count %u", addr, test_id, cid, fault_count);
    for(int i=0; i<fault_count; i++) {
        LOG_INF("Fault %u: 0x%02x", i, faults[i]);
    }
}

static struct bt_mesh_health_cli health_cli = {
    .current_status = disp_health_current_status,
};

static struct bt_mesh_model_pub sensor_pub = {
    .addr = GROUP_ADDR,     // use multicast group address
    .msg = NET_BUF_SIMPLE(SENSOR_PUB_MSG_SIZE),
};

static const struct bt_mesh_model models[] = {
    BT_MESH_MODEL_CFG_SRV,
    BT_MESH_MODEL_CFG_CLI(&cfg_cli),
    BT_MESH_MODEL_HEALTH_CLI(&health_cli),
    BT_MESH_MODEL(BT_MESH_MODEL_ID_SENSOR_SRV, sensor_srv_op, &sensor_pub, NULL),
    BT_MESH_MODEL(BT_MESH_MODEL_ID_SENSOR_CLI, sensor_cli_op, NULL, NULL),
};

static const struct bt_mesh_elem elements[] = {
    BT_MESH_ELEM(0, models, BT_MESH_MODEL_NONE),
};

static struct bt_mesh_comp comp  = {
    .cid = 0x0059, // Nordic CID
    .pid = 0x0001,
    .vid = 0x0002,
    .elem_count = ARRAY_SIZE(elements),
    .elem = elements,
};

// broadcast sensor data to all nodes on the network
static void broadcast_sensor_data(void)
{
    // wait for a provisionee node to register
    k_sem_take(&sem_prov_init, K_FOREVER);
    uint32_t random_delay_ms;
    for(;;) {
        // wait between 3 and 5 seconds before broadcasting
        random_delay_ms = 2000 + (sys_rand32_get() % 3001);

        k_sleep(K_MSEC(random_delay_ms));

        int err = publish_status(models[3], sensor_pub);
        if(err) {
            LOG_WRN("Failed to send sensor status with %d", err);
        }
    }
}

// --------------------------------
// general setup

// button callback handler
static void button_pushed(uint32_t b_state, uint32_t has_changed)
{
    // when button 1 is pushed, enable DFU temporarily
    if(has_changed & BUTTON & (b_state == 1)) {
        enable_dfu();
        
    }

    // when button 2 is pushed, clear active connections & resume advertising
    if(has_changed & BUTTON2 & b_state) {
        int err = bt_conn_disconnect(conn_curr, BT_HCI_ERR_REMOTE_USER_TERM_CONN);
        if(err) {
            LOG_INF("Failed to disconnect bluetooth clientwith %d", err);
            conn_curr = NULL;
        }
        bt_mesh_proxy_identity_enable();
    }

    // when button 3 is pressed, toggle air conditioning suppression
    if(has_changed & BUTTON3 & b_state) {
        sensor.suppressed = !sensor.suppressed;
        sensor.status = sensor.suppressed ? 0:calculate_sensor_status();
        LOG_INF("Air conditioning suppression status is now manually toggled: %u", sensor.suppressed);
    }
}

// --------------------------------------

static void prov_complete(uint16_t net_idx, uint16_t addr) {
    LOG_INF("Node {@ %u} has been succesfully provisioned", addr);
}

// callback for bt_enable
static void bt_done(int err) {

    static const struct bt_mesh_prov prov = {
    .uuid = dev_uuid,
    .node_added = prov_node_added, 
    .unprovisioned_beacon = prov_unprovisioned_beacon,
    .complete = prov_complete,
    };

    if(err) {
        LOG_ERR("Bluetooth enable failed with %d", err);
        return;
    }

    err = bt_mesh_init(&prov, &comp);
    if(err) {
        LOG_ERR("Mesh initialisation failed with %d", err);
        return;
    }

#ifdef CONFIG_BT_SETTINGS
    LOG_INF("Loading settings...");
    settings_subsys_init();
    err = settings_load();
    if(err && err !=-ENOENT) {
        LOG_WRN("Settings were enabled, but loading failed with %d", err);
    }
#endif

    k_event_post(&evnt_bt_init, BT_INIT_BIT);
}

// initialise buttons, LEDs, bluetooth. start advertising
static int init_components(void)
{
    sys_rand_get(dev_uuid, DEV_UUID_LEN);

    // initialise board buttons & add the handler
    int err =  dk_buttons_init(button_pushed);
    if(err) {
        LOG_ERR("Button init failed with %d", err);
        return -1;
    }

    // initialise LEDs
    err = dk_leds_init();
    if(err) {
        LOG_ERR("LED init failed with %d", err);
        return -1;
    }

    // fix address as EE:A6:76:8F:AC:B9
    static bt_addr_le_t addr = {
        .type = BT_ADDR_LE_RANDOM,
        .a = {{0xB9, 0xAC, 0x8F, 0x76, 0xA6, 0xEE}}
    };

    err = bt_id_create(&addr, NULL);
    if(err) {
        LOG_ERR("Obtaining bluetooth address failed with %d", err);
    }
    
    // initialise bluetooth
    err = bt_enable(bt_done);

    if(err) {
        LOG_ERR("Bluetooth init ended with %d", err);
        return -1;
    }

    // wait for async bt initialisation to complete
    k_event_wait(&evnt_bt_init, BT_INIT_BIT, false, K_FOREVER);

    err = prov_init();
    if (err) {
        LOG_ERR("Mesh provisioning init failed with %d", err);
        return -1;
    }

    bt_conn_cb_register(&conn_callbacks);

    err = proxy_gatt_init();
    if(err) {
        LOG_ERR("GATT initialisation failed with %d", err);
        return -1;
    }

    sensor.status = 1;
    return 0;
}

// regularly check for unprovisioned beacons to provision
static void handle_provisioner(void)
{
    k_event_wait(&evnt_bt_init, BT_INIT_BIT, false, K_FOREVER);
    for(;;) {
        prov_cycle();
        k_sleep(K_MSEC(MED_INTERVAL));
    }
}

int main(void) {
    int err;
    err = init_components();
    if(err) {
        LOG_ERR("Fatal component error. Shutting down.");
        return -1;
    }

    // add a callback handler to the advertising work queue
    k_work_init(&gatt_ad_work, start_gatt_ad);

    LOG_INF("Initialisation complete.");
    // advertise the mesh network under an identity
    err = bt_mesh_proxy_identity_enable();
    LOG_INF("Enabled proxy identity");
    return 0;
}

// thread for generating sensor data values periodically
K_THREAD_DEFINE(gen_sensor_data_thread, 4096, generate_sensor_data, NULL, NULL, NULL, 7, 0, 0);
// thread for transmitting sensor data values via GATT characteristics
K_THREAD_DEFINE(send_sensor_data_thread, 4096, send_sensor_data, NULL, NULL, NULL, 7, 0, 0);
// thread for broadcasting sensor data values via mesh
K_THREAD_DEFINE(broadcast_data_thread, 4096, broadcast_sensor_data, NULL, NULL, NULL, 7, 0, 0);
// thread for provisioning nodes
K_THREAD_DEFINE(provisioning_thread, 4096, handle_provisioner, NULL, NULL, NULL, 7, 0, 0);
```

## src/provisioner.c
```c
#include <zephyr/bluetooth/mesh.h>
#include <zephyr/logging/log.h>
#include <zephyr/random/random.h>

LOG_MODULE_DECLARE(main_log);

#include "provisioner.h"
#include "common.h"

K_SEM_DEFINE(sem_unprov_beacon, 0, 1);
K_SEM_DEFINE(sem_node_added, 0, 1);
K_SEM_DEFINE(sem_prov_init, 0, 1);

static uint16_t self_addr=1;
static uint8_t node_uuid[16];
static int is_self_configured = 0;

// an unprovisioned node has been added to the network
void prov_node_added(uint16_t net_idx, uint8_t uuid[16], uint16_t addr, uint8_t num_elem)
{
    k_sem_give(&sem_node_added);
}

// an unprovisioned beacon has been detected
void prov_unprovisioned_beacon(uint8_t uuid[16], bt_mesh_prov_oob_info_t oob_info, uint32_t *uri_hash) 
{
    
    if(memcmp(uuid, node_uuid, 16) != 0) {
        LOG_INF("Detected new unprovisioned beacon with UUID: %02X %02X %02X %02X %02X %02X %02X %02X %02X %02X %02X %02X %02X %02X %02X %02X",
            uuid[0], uuid[1], uuid[2], uuid[3], uuid[4], uuid[5], uuid[6], uuid[7], uuid[8], uuid[9], uuid[10], uuid[11], uuid[12], uuid[13], uuid[14], uuid[15]);
        memcpy(node_uuid, uuid, 16);
        k_sem_give(&sem_unprov_beacon);
    }
}

// configure the new CDB
static int setup_cdb(uint8_t net_key[16])
{
    uint8_t app_key[16];
    struct bt_mesh_cdb_app_key *key;

    // allocate a subnet to the net_idx
    struct bt_mesh_cdb_subnet *subnet = bt_mesh_cdb_subnet_get(NET_IDX);
    int err;
    if(subnet != NULL) {
        // if that subnet has a stale key
        if(subnet->keys[0].net_key.key == PSA_KEY_ID_NULL) {
            LOG_INF("Subnet already existed, but key retrieval failed. Regenerating key...");
            err = bt_mesh_cdb_subnet_key_import(subnet, 0, net_key);
            if(err) {
                LOG_ERR("Subnet import failed with %d", err);
                return err;
            }
        }
    } 
    else {
        LOG_INF("Creating new subnet for net_idx %d", NET_IDX);
        subnet = bt_mesh_cdb_subnet_alloc(NET_IDX);

        if(subnet == NULL) {
            LOG_ERR("Subnet allocation failed (max subnet count reached?).");
            return -1;
        }
        
        // import the network key into the subnet
        err = bt_mesh_cdb_subnet_key_import(subnet, 0, net_key);
        if(err) {
            LOG_ERR("Subnet import failed with %d", err);
            return err;
        }

        if(IS_ENABLED(CONFIG_BT_SETTINGS)) {
            bt_mesh_cdb_subnet_store(subnet);
        }
    }

    // if a key using that APP_IDX already exists
    key = bt_mesh_cdb_app_key_get(APP_IDX);
    if(key != NULL) {
        LOG_INF("App key exists, using existing.");
    }
    else {
        // generate an application key by APP_IDX
        key = bt_mesh_cdb_app_key_alloc(NET_IDX, APP_IDX);
        if(key == NULL) {
            LOG_ERR("App key allocation failed.");
            return -1;
        }
    
        sys_rand_get(app_key, sizeof(app_key));
        err = bt_mesh_cdb_app_key_import(key, 0, app_key);
        if(err) {
            LOG_ERR("Appkey CBD import failed with %d", err);
            return err;
        }
        
        if(IS_ENABLED(CONFIG_BT_SETTINGS)) {
            bt_mesh_cdb_app_key_store(key);
        }
    }

    return 0;
}

// re-configure all active nodes
static uint8_t unflag_nodes(struct bt_mesh_cdb_node *node, void *data)
{
    atomic_clear_bit(node->flags, BT_MESH_CDB_NODE_CONFIGURED);
    return 0;
}

// create (or retrieve) a network key & enable provisioning
int prov_init(void)
{
    uint8_t dev_key[16], net_key[16];
    int err;

    sys_rand_get(net_key, sizeof(net_key));

    err = bt_mesh_cdb_create(net_key);
    if(err == -EALREADY) {
        LOG_INF("Using stored CDB");
    }
    else if (err)  {
        LOG_INF("Initial CDB creation failed with %d", err);
        return err;
    } 
    else {
        LOG_INF("Creating new CDB");
        atomic_set_bit(bt_mesh_cdb.flags, BT_MESH_CDB_VALID);
        setup_cdb(net_key);
    }

    LOG_INF("CDB main settings have been initialised");

    // wait for initialisation to settle
    sys_rand_get(dev_key, 16);
    // since this is initialisation, assume the iv index is 0
    err = bt_mesh_provision(net_key, NET_IDX, 0, 0, self_addr, dev_key);
    if(err == -EALREADY) {
        LOG_INF("Already provisioned, using existing network key.");
    } 
    else if(err) {
        LOG_ERR("Provisioning failed with %d", err);
        return err;
    }

    // for debug purposes
    bt_mesh_cdb_node_foreach(unflag_nodes, NULL);
    return 0;
}

// get application key by index & add to the target node
static int ret_add_app_key(struct bt_mesh_cdb_node *node, bool is_remote)
{
    struct bt_mesh_cdb_app_key *key;
    uint8_t status = 0;
    uint8_t app_key[16];

    key = bt_mesh_cdb_app_key_get(APP_IDX);
    if(key == NULL) {
        LOG_ERR("No appkey assigned.");
        return -1;
    }

    int err = bt_mesh_cdb_app_key_export(key, 0, app_key);
    if(err) {
        LOG_ERR("Appkey export from CBD failed with %d", err);
        return err;
    }

    uint8_t net_key[16];
    bt_mesh_cdb_subnet_key_export(bt_mesh_cdb_subnet_get(NET_IDX), 0, net_key);

    // add subnet netkey to the node
    err = bt_mesh_cfg_cli_net_key_add(NET_IDX, node->addr, key->net_idx, net_key, &status);
    if(err || status) {
        LOG_ERR("Adding the netkey failed with %d (status %d)", err, status);
        return err;
    }

    k_sleep(K_MSEC(MED_INTERVAL));

    if(is_remote) {
        // add appkey to the node
        err = bt_mesh_cfg_cli_app_key_add(NET_IDX, node->addr, key->net_idx, key->app_idx, app_key, &status);
        if(err || status) {
            LOG_ERR("Adding the appkey failed with %d (status %d)", err, status);
            return err;
        }
    }
    else {
        err = bt_mesh_app_key_add(key->app_idx, NET_IDX, app_key);
        if(err) {
            LOG_ERR("Adding the appkey failed with %d (status %d)", err, status);
            return err;
        }
    }
    return 0;
}

// provision self
static int configure_self(struct bt_mesh_cdb_node *self)
{
    uint8_t status = 0;
    
    int err =  ret_add_app_key(self, 0);
    if(err) {
        LOG_ERR("Appkey addition to self failed with %d", err);
        return err;
    }
    
    // bind the sensor client model to the appkey
    err = bt_mesh_cfg_cli_mod_app_bind(self->net_idx, self->addr, self->addr, APP_IDX, BT_MESH_MODEL_ID_SENSOR_CLI, &status);
    if(err || status) {
        LOG_ERR("Appkey binding for sensor client failed with %d (status %d)", err, status);
        return err;
    }

    // bind the sensor server model to the appkey
    err = bt_mesh_cfg_cli_mod_app_bind(self->net_idx, self->addr, self->addr, APP_IDX, BT_MESH_MODEL_ID_SENSOR_SRV, &status);
    if(err || status) {
        LOG_ERR("Appkey binding for sensor server failed with %d (status %d)", err, status);
        return err;
    }

    atomic_set_bit(self->flags, BT_MESH_CDB_NODE_CONFIGURED);
    is_self_configured = 1;

    if (IS_ENABLED(CONFIG_BT_SETTINGS)) {
        bt_mesh_cdb_node_store(self);
	}

    LOG_INF("Self-configuration complete.");

    // subscribe to the sensor server model
    err = bt_mesh_cfg_cli_mod_sub_add(self->net_idx, self->addr, self->addr, GROUP_ADDR, BT_MESH_MODEL_ID_SENSOR_SRV, &status);
    if (err || status) {
        LOG_WRN("Subscribing to sensor readings failed with %d (status %d)", err, status);
    }

    err = bt_mesh_cfg_cli_mod_sub_add(self->net_idx, self->addr, self->addr, GROUP_ADDR, BT_MESH_MODEL_ID_SENSOR_CLI, &status);
    if (err || status) {
        LOG_WRN("Subscribing to sensor readings failed with %d (status %d)", err, status);
    }

    k_sleep(K_MSEC(MED_INTERVAL));

    // wake blocked threads
    k_sem_give(&sem_prov_init);
    return 0;
}

// provision a managed node
static int configure_node(struct bt_mesh_cdb_node *node)
{
    NET_BUF_SIMPLE_DEFINE(buf, BT_MESH_RX_SDU_MAX);
	struct bt_mesh_comp_p0_elem elem;
	struct bt_mesh_comp_p0 comp;
	uint8_t status = 0;

    LOG_INF("Configuring node %d", node->addr);

    int err = ret_add_app_key(node, 1);
    if(err) {
        LOG_ERR("Appkey addition to node failed with %d", err);
        return err;
    }

    k_sleep(K_MSEC(SHORT_INTERVAL));

    LOG_INF("Retrieving composition data from node %d with NET_IDX %u", node->addr, NET_IDX);

    uint8_t rsp = 0;
    err = bt_mesh_cfg_cli_comp_data_get(NET_IDX, node->addr, 0, &rsp, &buf);
    if(err || (rsp != 0)) {
        LOG_ERR("Data composition retrieval failed with %d (response %u)", err, rsp);
        return err;
    }

    err = bt_mesh_comp_p0_get(&comp, &buf);
    if(err) {
        LOG_ERR("Composition data parsing failed with %d", err);
        return err;
    }

    int elem_addr = node->addr;
    // while there are still unbound elements
    while(bt_mesh_comp_p0_elem_pull(&comp, &elem)) {
        LOG_INF("Node %u comprises %u SIG models & %u vendor models", elem_addr, elem.nsig, elem.nvnd);

        // bind appkey to all SIG models in the element
        for(int i=0; i<elem.nsig; i++) {
            uint16_t id = bt_mesh_comp_p0_elem_mod(&elem, i);

            // choosing to not bind the configuration models (they're handled by the mesh stack directly)
			if (id == BT_MESH_MODEL_ID_CFG_CLI ||
			    id == BT_MESH_MODEL_ID_CFG_SRV) {
				continue;
			}

            LOG_INF("Binding SIG model, id #%u", id);
			err = bt_mesh_cfg_cli_mod_app_bind(NET_IDX, node->addr, elem_addr, APP_IDX, id, &status);
			if (err || status) {
				LOG_ERR("Binding application to SIG model failed with %d (status %d)", err, status);
                return err;
			}
        }

        elem_addr ++;
    }

    atomic_set_bit(node->flags, BT_MESH_CDB_NODE_CONFIGURED);

    if (IS_ENABLED(CONFIG_BT_SETTINGS)) {
        bt_mesh_cdb_node_store(node);
	}

    // force node to subscribe to the sensor server model
    err = bt_mesh_cfg_cli_mod_sub_add(node->net_idx, node->addr, node->addr, GROUP_ADDR, BT_MESH_MODEL_ID_SENSOR_SRV, &status);
    if (err || status) {
        LOG_WRN("Node subscribing to sensor readings failed with %d (status %d)", err, status);
    }

    err = bt_mesh_cfg_cli_mod_sub_add(node->net_idx, node->addr, node->addr, GROUP_ADDR, BT_MESH_MODEL_ID_SENSOR_CLI, &status);
    if (err || status) {
        LOG_WRN("Subscribing to sensor readings failed with %d (status %d)", err, status);
    }

    k_sleep(K_MSEC(MED_INTERVAL));

    LOG_INF("Node configuration complete.");
    return 0;
}

// check if a node is unconfigured
static uint8_t check_unconfigured(struct bt_mesh_cdb_node *node, void *data)
{
    int err;
	if (!atomic_test_bit(node->flags, BT_MESH_CDB_NODE_CONFIGURED)) {

        if (node->addr == self_addr) {
			err = configure_self(node);
            if(err) {
                LOG_ERR("Self-configuration failed with %d", err);
                return BT_MESH_CDB_ITER_STOP;
            }
		} 
        else {
			err = configure_node(node);
            if(err) {
                LOG_WRN("Node configuration failed with %d", err);
                bt_mesh_cdb_node_del(node, 1);
            }
		}
	}
	return BT_MESH_CDB_ITER_CONTINUE;
}

// wait for nodes with unprovisioned beacons in range
void prov_cycle(void)
{
    k_sem_reset(&sem_unprov_beacon);
    k_sem_reset(&sem_node_added);
    bt_mesh_cdb_node_foreach(check_unconfigured, NULL);
    
    while(!is_self_configured) {
        LOG_INF("Self is not configured");
        k_sleep(K_MSEC(MED_INTERVAL));
        return;
    }

    LOG_INF("(Searching for unprovisioned beacons...)");
    int err = k_sem_take(&sem_unprov_beacon, K_SECONDS(5));
    if (err == -EAGAIN) {
        return;
    } else if (err != 0) {
        LOG_INF("Beaconing sephamore failed with %d", err);
    }

    LOG_INF("Provisioning...");
    err = bt_mesh_provision_adv(node_uuid, NET_IDX, 0, 5);
    if(err) {
        LOG_ERR("Provisioning node failed with %d", err);
        return;
    }

    LOG_INF("(Waiting for the node to be added...)");
    err = k_sem_take(&sem_node_added, K_SECONDS(5));
    if (err) {
        LOG_INF("Node addition failed with %d", err);
        return;
    } 
    else {
        LOG_INF("Mode added succesfully.");
    }
}
```

## src/provisioner.h
```c
#ifndef PROXY_PROVISIONER_H_
#define PROXY_PROVISIONER_H_

#include <zephyr/bluetooth/mesh.h>

#define NET_IDX BT_MESH_NET_PRIMARY

int prov_init(void);
void prov_node_added(uint16_t net_idx, uint8_t uuid[16], uint16_t addr, uint8_t num_elem);
void prov_unprovisioned_beacon(uint8_t uuid[16], bt_mesh_prov_oob_info_t oob_info, uint32_t *uri_hash);
void prov_cycle(void);

extern struct k_sem sem_prov_init;

#endif
```

## src/proxy_gatt.c
```c
#include <zephyr/types.h>
#include <zephyr/bluetooth/uuid.h>
#include <zephyr/bluetooth/gatt.h>
#include <zephyr/logging/log.h>
#include <zephyr/bluetooth/conn.h>
#include <dk_buttons_and_leds.h>
#include <mbedtls/sha256.h>
#include <zephyr/fs/fs.h>
#include <stdio.h>

#ifdef CONFIG_BOOTLOADER_MCUBOOT
#include <zephyr/mgmt/mcumgr/transport/smp_bt.h>
#endif

LOG_MODULE_DECLARE(main_log);

#include "proxy_gatt.h"
#include "common.h"
#include "mesh.h"

// DFU window is currently at 4 minutes 
#define DFU_TIMEOUT_MAX         240
#define DEVICE_NAME_LEN         sizeof(CONFIG_BT_DEVICE_NAME)

static const char *suppression_pw_hash = "5e884898da28047151d0e56f8dc6292773603d0d6aabbdd62a11ef721d1542d8";

// static bool  button_state;
static bool sensor_notify_enabled = 0;
static bool suppression_indicate_enabled = 0;
static bool status_indicate_enabled = 0;
static bool dfu_enabled = 0;
static struct k_timer dfu_timeout;
static struct k_work disable_dfu_work;
static struct bt_gatt_indicate_params ind_params;

struct bt_conn *conn_curr = NULL;

// response data is defined locally, to facilitate network name changes
static struct bt_data ad[] = {
    BT_DATA_BYTES(BT_DATA_FLAGS, (BT_LE_AD_GENERAL | BT_LE_AD_NO_BREDR)),
    BT_DATA_BYTES(BT_DATA_UUID128_ALL, BT_UUID_PROXY_GATT_VAL),
};

static struct bt_le_ext_adv *gatt_adv;
static const struct bt_le_adv_param gatt_adv_params = {
    .id = BT_ID_DEFAULT,
    .sid = 0,
    .options = BT_LE_ADV_OPT_CONN,
    .interval_min = BT_GAP_ADV_FAST_INT_MIN_2,
    .interval_max = BT_GAP_ADV_FAST_INT_MAX_2,
    .peer = NULL,
};

#ifdef CONFIG_BOOTLOADER_MCUBOOT

// update advertising data with the SMP service UUID & register the SMP service
void enable_dfu(void)
{
    if(dfu_enabled) {
        return;
    }
  
    const struct bt_data dfu_sd[] = {
        BT_DATA(BT_DATA_NAME_SHORTENED, CONFIG_BT_DEVICE_NAME, DEVICE_NAME_LEN),
        BT_DATA_BYTES(BT_DATA_UUID128_ALL, SMP_BT_SVC_UUID_VAL),
    };

    int err = bt_le_ext_adv_stop(gatt_adv);
    if (err) {
        LOG_INF("Failed to stop previously running adv (was anything here?)");
    }

    k_sleep(K_MSEC(MED_INTERVAL));
    smp_bt_register();

    err = bt_le_ext_adv_set_data(gatt_adv, ad, ARRAY_SIZE(ad), dfu_sd, ARRAY_SIZE(dfu_sd));
    if(!err){
        err = bt_le_ext_adv_start(gatt_adv, BT_LE_EXT_ADV_START_DEFAULT);
    }
    if(err) {
        LOG_WRN("Starting ext adv failed with %d", err);
    }
    
    LOG_INF("Enabled DFU");
    dfu_enabled = 1;
    dk_set_led(DFU_LED, dfu_enabled);

    k_timer_start(&dfu_timeout, K_SECONDS(DFU_TIMEOUT_MAX), K_NO_WAIT);
}

// remove the SMP service UUID from the advertising data & unregister the SMP service
void disable_dfu(struct k_work *k_work)
{
    LOG_INF("Disabling DFU");
    int err = bt_le_ext_adv_stop(gatt_adv);
    if (err) {
        LOG_INF("Failed to stop previously running adv (was anything here?)");
    }

    k_sleep(K_MSEC(MED_INTERVAL));

    const struct bt_data gatt_sd[] = {
        BT_DATA(BT_DATA_NAME_SHORTENED, CONFIG_BT_DEVICE_NAME, DEVICE_NAME_LEN),
    };

    smp_bt_unregister();

    err = bt_le_ext_adv_set_data(gatt_adv, ad, ARRAY_SIZE(ad), gatt_sd, ARRAY_SIZE(gatt_sd));
    if(!err){
        err = bt_le_ext_adv_start(gatt_adv, BT_LE_EXT_ADV_START_DEFAULT);
    }
    if(err) {
        LOG_WRN("Starting ext adv failed with %d", err);
    }

    if(err) {
        LOG_WRN("Disabling DFU advertisement failed with %d", err);
    }

    LOG_INF("Disabled DFU");
    dfu_enabled = 0;
    dk_set_led(DFU_LED, dfu_enabled);
}

// wait for DFU to timeout before disabling it
void timeout_dfu(struct k_timer *timer)
{
    k_work_submit(&disable_dfu_work);
}
#endif

// change the network name
static ssize_t write_name_value(struct bt_conn *conn, const struct bt_gatt_attr *attr, const void *buf, uint16_t len, uint16_t offset, uint8_t flags)
{
    char local_name[32];
    // unsafe, for demo purposes
    memcpy(local_name, buf, len);
    LOG_INF("New network name has been assigned by external client - now %s", local_name);
    return sizeof(local_name);
}

// change the acceptable temperature threshold
static ssize_t write_threshold_value(struct bt_conn *conn, const struct bt_gatt_attr *attr, const void *buf, uint16_t len, uint16_t offset, uint8_t flags)
{
    uint8_t new_threshold = *((uint8_t *)buf);

    if(new_threshold >= 10 && new_threshold <= 40) {
        LOG_INF("Recieved new temperature threshold value - now %u", new_threshold);
        memcpy(&sensor.threshold, &new_threshold, len);
    }

    else {
        LOG_WRN("New threshold was out of safe range (10<=x<=40), please try again");
    }
    return 0;
}

// compare input password hash to stored password hash - if they match, toggle suppression
static ssize_t write_manual_suppression_value(struct bt_conn *conn, const struct bt_gatt_attr *attr, const void *buf, uint16_t len, uint16_t offset, uint8_t flags)
{
    unsigned char pw_hash[32];

    char pw[len+1];
    memcpy(&pw, buf, len);
    pw[len] = '\0';
    mbedtls_sha256((unsigned char*)pw, len, pw_hash, 0);

    char pw_hash_str[65];
    for (int i = 0; i < 32; i++) {
        snprintf(&pw_hash_str[i*2], 3, "%02x", pw_hash[i]);
    }

    if(strcmp(pw_hash_str, suppression_pw_hash) == 0) {
        LOG_INF("Suppression password accepted");
        sensor.suppressed = !sensor.suppressed;
        LOG_INF("Sensor suppression changed by external client - now %s", sensor.suppressed ? "ON":"OFF");
        return 0;
    }

    LOG_INF("Suppression password hash didn't match as expected.");
    return -1;
}

// callback functions for indication and notification changes
static void status_ccc_config_changed(const struct bt_gatt_attr *attr, uint16_t value)
{
    status_indicate_enabled = (value == BT_GATT_CCC_INDICATE);
    LOG_INF("Status CCC - indicate enabled is now %u", status_indicate_enabled);
}

static void suppression_ccc_config_changed(const struct bt_gatt_attr *attr, uint16_t value)
{
    suppression_indicate_enabled = (value == BT_GATT_CCC_INDICATE);
    LOG_INF("Suppression CCC - indicate enabled is now %u", suppression_indicate_enabled);
}

static void sensor_ccc_config_changed(const struct bt_gatt_attr *attr, uint16_t value)
{
    sensor_notify_enabled = (value == BT_GATT_CCC_NOTIFY);
    LOG_INF("Sensor CCC - notify enabled is now %u", sensor_notify_enabled);
}

static ssize_t read_status_value(struct bt_conn *conn, const struct bt_gatt_attr *attr, void *buf, uint16_t len, uint16_t offset)
{
    return bt_gatt_attr_read(conn, attr, buf, len, offset, &sensor.status, sizeof(sensor.status));
}

static ssize_t read_suppression_value(struct bt_conn *conn, const struct bt_gatt_attr *attr, void *buf, uint16_t len, uint16_t offset)
{
    return bt_gatt_attr_read(conn, attr, buf, len, offset, &sensor.suppressed, sizeof(sensor.suppressed));
}

static struct bt_gatt_attr proxy_gatt_attrs[] = {
    BT_GATT_PRIMARY_SERVICE(BT_UUID_PROXY_GATT),
    // define status characteristic, with indicate & read permission
    BT_GATT_CHARACTERISTIC(BT_UUID_PROXY_GATT_STATUS, BT_GATT_CHRC_READ | BT_GATT_CHRC_INDICATE, BT_GATT_PERM_READ, read_status_value, NULL, NULL),
    // define suppression characteristic, with indicate & read permission
    BT_GATT_CHARACTERISTIC(BT_UUID_PROXY_GATT_SUPPRESSION, BT_GATT_CHRC_READ | BT_GATT_CHRC_INDICATE, BT_GATT_PERM_READ, read_suppression_value, NULL, NULL),
    // define system  value characteristic, with notify permission
    BT_GATT_CHARACTERISTIC(BT_UUID_PROXY_GATT_SENSOR, BT_GATT_CHRC_NOTIFY, BT_GATT_PERM_NONE, NULL, NULL, NULL),
    // define name change, threshold change, and manual suppression characteristic, with write permission
    BT_GATT_CHARACTERISTIC(BT_UUID_PROXY_GATT_NAME, BT_GATT_CHRC_WRITE, BT_GATT_PERM_WRITE, NULL, write_name_value, NULL),
    BT_GATT_CHARACTERISTIC(BT_UUID_PROXY_GATT_THRESHOLD, BT_GATT_CHRC_WRITE, BT_GATT_PERM_WRITE, NULL, write_threshold_value, NULL), 
    BT_GATT_CHARACTERISTIC(BT_UUID_PROXY_GATT_MANUAL_SUPPRESS, BT_GATT_CHRC_WRITE, BT_GATT_PERM_WRITE, NULL, write_manual_suppression_value, NULL),
    // define callbacks for indication and notification subscription
    BT_GATT_CCC(status_ccc_config_changed, BT_GATT_PERM_READ | BT_GATT_PERM_WRITE),
    BT_GATT_CCC(sensor_ccc_config_changed, BT_GATT_PERM_READ | BT_GATT_PERM_WRITE),
    BT_GATT_CCC(suppression_ccc_config_changed, BT_GATT_PERM_READ | BT_GATT_PERM_WRITE),
};

static struct bt_gatt_service proxy_gatt_service = BT_GATT_SERVICE(proxy_gatt_attrs);

// register the custom gatt service
// this (and unregister_proxy_gatt) are mainly left over from when GATT was toggled with each BT connection
void register_proxy_gatt(void)
{
    int err = bt_gatt_service_register((struct bt_gatt_service *)&proxy_gatt_service);
    if(err) {
        LOG_WRN("Registering custom gatt services failed with %d", err);
        return;
    }
    LOG_INF("Succesfully registered custom gatt services");
}

// unregister the custom gatt service
void unregister_proxy_gatt(void)
{
    int err = bt_gatt_service_unregister((struct bt_gatt_service *)&proxy_gatt_service);
    if(err) {
        LOG_WRN("Unregistering custom gatt services failed with %d", err);
    }

    sensor_notify_enabled = 0;
    status_indicate_enabled = 0;
    suppression_indicate_enabled=0;
    LOG_INF("Unregistered custom gatt service");
}

// send sensor notifications to a gatt connection with notify enabled
int send_sensor_notification()
{
    if(!sensor_notify_enabled || conn_curr == NULL) {
        return 0;
    }
    return bt_gatt_notify(conn_curr, &proxy_gatt_service.attrs[8], &sensor.value, sizeof(sensor.value));
}

// send status indications to a gatt connection
int send_status_indication()
{
    if(!status_indicate_enabled || conn_curr == NULL) {
        return -1;
    }

    ind_params.attr = &proxy_gatt_service.attrs[2];
    ind_params.data = &sensor.status;
    ind_params.len = sizeof(sensor.status);

    return bt_gatt_indicate(conn_curr, &ind_params);
}

// send suppression indications to a gatt connection
int send_suppression_indication()
{
    if(!suppression_indicate_enabled || conn_curr == NULL) {
        return 0;
    }

    ind_params.attr = &proxy_gatt_service.attrs[5];
    ind_params.data = &sensor.suppressed;
    ind_params.len = sizeof(sensor.suppressed);

    return bt_gatt_indicate(conn_curr, &ind_params);
}

// begin the gatt advertisiing bearer
void start_gatt_ad(struct k_work *work)
{
    const struct bt_data gatt_sd[] = {
        BT_DATA(BT_DATA_NAME_SHORTENED, CONFIG_BT_DEVICE_NAME, DEVICE_NAME_LEN),
    };
    
    int err = bt_le_ext_adv_stop(gatt_adv);
    if (err) {
        LOG_INF("Failed to stop previously running adv (was anything here?)");
    }
    
    k_sleep(K_MSEC(MED_INTERVAL));
    LOG_WRN("Starting Gatt");

    err = bt_le_ext_adv_set_data(gatt_adv, ad, ARRAY_SIZE(ad), gatt_sd, ARRAY_SIZE(gatt_sd));
    if(!err){
        err = bt_le_ext_adv_start(gatt_adv, BT_LE_EXT_ADV_START_DEFAULT);
    }
    if(err) {
        LOG_WRN("Starting ext adv failed with %d", err);
    }
    
    LOG_INF("Advertising commencing.");
}

// init for registering callbacks for characteristic polling
int proxy_gatt_init() 
{
    register_proxy_gatt();
    k_work_init(&disable_dfu_work, disable_dfu);
    k_timer_init(&dfu_timeout, timeout_dfu, NULL);

#ifdef CONFIG_BOOTLOADER_MCUBOOT
    int err = smp_bt_unregister();
    if(err) {
        LOG_WRN("Failed to unregister SMP with %d", err);
    }
#endif

    err = bt_le_ext_adv_create(&gatt_adv_params, NULL, &gatt_adv);
    if(err) {
        LOG_WRN("Failed to create adv set with %d", err);
        return err;
    }

    attach_gatt_callbacks(send_status_indication, send_suppression_indication);
    return 0;
}
```

## src/proxy_gatt.h
```c
#ifndef PROXY_GATT_H_
#define PROXY_GATT_H_

#include <zephyr/types.h>
#include <stdbool.h>
#include <zephyr/bluetooth/conn.h>


// service UUID
#define BT_UUID_PROXY_GATT_VAL \
	BT_UUID_128_ENCODE(0xb0000001, 0x67bd, 0x4eab, 0xaea8, 0xe29e731dd4cd)

#define BT_UUID_PROXY_GATT BT_UUID_DECLARE_128(BT_UUID_PROXY_GATT_VAL)

// status characteristic UUID
#define BT_UUID_PROXY_GATT_STATUS_VAL \
    BT_UUID_128_ENCODE(0xb0000201, 0x67bd, 0x4eab, 0xaea8, 0xe29e731dd4cd)

#define BT_UUID_PROXY_GATT_STATUS BT_UUID_DECLARE_128(BT_UUID_PROXY_GATT_STATUS_VAL)

// suppression (info) characteristic UUID
#define BT_UUID_PROXY_GATT_SUPPRESSION_VAL \
    BT_UUID_128_ENCODE(0xb0000202, 0x67bd, 0x4eab, 0xaea8, 0xe29e731dd4cd)

#define BT_UUID_PROXY_GATT_SUPPRESSION BT_UUID_DECLARE_128(BT_UUID_PROXY_GATT_SUPPRESSION_VAL)

// sensor characteristic UUID
#define BT_UUID_PROXY_GATT_SENSOR_VAL \
    BT_UUID_128_ENCODE(0xb0000003, 0x67bd, 0x4eab, 0xaea8, 0xe29e731dd4cd)

#define BT_UUID_PROXY_GATT_SENSOR BT_UUID_DECLARE_128(BT_UUID_PROXY_GATT_SENSOR_VAL)

// name characteristic UUID
#define BT_UUID_PROXY_GATT_NAME_VAL \
    BT_UUID_128_ENCODE(0xb0000401, 0x67bd, 0x4eab, 0xaea8, 0xe29e731dd4cd)

#define BT_UUID_PROXY_GATT_NAME BT_UUID_DECLARE_128(BT_UUID_PROXY_GATT_NAME_VAL)

// threshold characteristic UUID
#define BT_UUID_PROXY_GATT_THRESHOLD_VAL \
    BT_UUID_128_ENCODE(0xb0000402, 0x67bd, 0x4eab, 0xaea8, 0xe29e731dd4cd)

#define BT_UUID_PROXY_GATT_THRESHOLD BT_UUID_DECLARE_128(BT_UUID_PROXY_GATT_THRESHOLD_VAL)

#define BT_UUID_PROXY_GATT_MANUAL_SUPPRESS_VAL \
BT_UUID_128_ENCODE(0xb0000005, 0x67bd, 0x4eab, 0xaea8, 0xe29e731dd4cd)

#define BT_UUID_PROXY_GATT_MANUAL_SUPPRESS BT_UUID_DECLARE_128(BT_UUID_PROXY_GATT_MANUAL_SUPPRESS_VAL)

typedef bool (*name_cb_t)(const char *);

extern struct bt_conn *conn_curr;

int proxy_gatt_init();
int send_sensor_notification();
int send_suppression_indication();
int send_status_indication();
void start_gatt_ad(struct k_work *work);
void enable_dfu(void);
void register_proxy_gatt(void);
void unregister_proxy_gatt(void);

#endif
```
